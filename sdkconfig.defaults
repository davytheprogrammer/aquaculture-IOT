## sdkconfig.defaults
```kconfig
# Main task stack size
CONFIG_ESP_MAIN_TASK_STACK_SIZE=16384

# Increase HTTP buffer size
CONFIG_HTTPD_MAX_REQ_HDR_LEN=1024
CONFIG_HTTPD_MAX_URI_LEN=1024

# Enable PSRAM if available
CONFIG_ESP32S3_SPIRAM_SUPPORT=y

# Increase task watchdog timeout
CONFIG_ESP_TASK_WDT_TIMEOUT_S=10

# TCP/IP settings
CONFIG_LWIP_TCP_SND_BUF_DEFAULT=5744
CONFIG_LWIP_TCP_WND_DEFAULT=5744
CONFIG_LWIP_TCP_RECVMBOX_SIZE=64

# SSL/TLS settings
CONFIG_ESP_TLS_INSECURE=n
CONFIG_ESP_TLS_SERVER=n
CONFIG_ESP_TLS_PSK_VERIFICATION=n
CONFIG_ESP_TLS_CLIENT_SESSION_TICKETS=n
CONFIG_MBEDTLS_SSL_PROTO_TLS1_2=y
CONFIG_MBEDTLS_SSL_PROTO_TLS1_3=y
CONFIG_MBEDTLS_CERTIFICATE_BUNDLE=y
CONFIG_MBEDTLS_CERTIFICATE_BUNDLE_DEFAULT_CMN=y
CONFIG_MBEDTLS_DYNAMIC_BUFFER=y
CONFIG_MBEDTLS_DYNAMIC_FREE_CONFIG_DATA=y
CONFIG_MBEDTLS_DYNAMIC_FREE_CA_CERT=y
```
